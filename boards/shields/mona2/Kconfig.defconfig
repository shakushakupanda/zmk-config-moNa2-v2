## boards/shields/mona2/Kconfig.defconfig
```kconfig
if SHIELD_MONA2_R

config ZMK_KEYBOARD_NAME
    default "mona2"

config ZMK_BLE
    default y

config ZMK_SPLIT_ROLE_CENTRAL
    default y

config INPUT
    default y

config ZMK_POINTING
    default y

config SPI
    default y

config PAW3222
    default y

endif

if SHIELD_MONA2_R || SHIELD_MONA2_L

config NFCT_PINS_AS_GPIOS
    default y

config ZMK_SPLIT
    default y

config RGBLED_WIDGET_BATTERY_LEVEL_HIGH
    default 30

config RGBLED_WIDGET_BATTERY_LEVEL_CRITICAL
    default 10

endif
```

## boards/shields/mona2/Kconfig.shield
```kconfig
config SHIELD_MONA2_R
    def_bool $(shields_list_contains,mona2_r)

config SHIELD_MONA2_L
    def_bool $(shields_list_contains,mona2_l)

config TRACKBALL_PAW3222
    bool "Use PAW3222 sensor on mona2 instead of PMW3610"
    depends on SHIELD_MONA2_R
    default n
    select PAW3222
    help
      When y, the right-half (central) firmware is built with the
      PAW3222 trackball driver instead of the default PMW3610.
      Pick the matching UF2 to flash depending on which sensor is
      physically installed.
```

## config/west.yml
```yaml
manifest:
  remotes:
    - name: zmkfirmware
      url-base: https://github.com/zmkfirmware
    - name: cormoran    # <-- DYA Studio (custom ZMK fork + modules)
      url-base: https://github.com/cormoran
    - name: sayu-hub
      url-base: https://github.com/sayu-hub
    - name: badjeff    # <-- PMW3610
      url-base: https://github.com/badjeff
    # - name: sekigon-gonnoc  # <-- PAW3222
    #   url-base: https://github.com/sekigon-gonnoc
    - name: caksoylar  # <-- RGB LED
      url-base: https://github.com/caksoylar
    - name: zettaface  # <-- Input Processor Keybind
      url-base: https://github.com/zettaface
  projects:
    # ── ZMK 本体は cormoran さんの DYA Studio 対応 fork に切替 ──
    - name: zmk
      remote: cormoran
      revision: v0.3-branch+dya
      import: app/west.yml
    # ── DYA Studio modules ──
    - name: zmk-module-ble-management
      remote: cormoran
      revision: main
    - name: zmk-module-battery-history
      remote: cormoran
      revision: main
    - name: zmk-module-settings-rpc
      remote: cormoran
      revision: main
    - name: zmk-module-runtime-input-processor
      remote: cormoran
      revision: main
    # ── 既存モジュール ──
    - name: zmk-pmw3610-driver
      remote: badjeff
      revision: zmk-0.3
    # - name: zmk-driver-paw3222
    #   remote: sekigon-gonnoc
    #   revision: main
    - name: zmk-rgbled-widget
      remote: caksoylar
      revision: v0.3
    - name: zmk-input-processor-keybind
      remote: zettaface
      revision: main
  self:
    path: config
```
