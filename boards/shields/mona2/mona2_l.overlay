#include "mona2.dtsi"
/* mona2.dtsi 内で RC(row,col) のマトリクス展開が終わった後に include する
   (LEFT 側でも runtime processor ノードを定義しないと
   /runtime_input_processor が空ノード扱いになり processor-label エラーになるため) */
#include <input/processors/runtime-input-processor.dtsi>

&kscan0 {
        col-gpios
            = <&xiao_d 10 GPIO_ACTIVE_HIGH>
            , <&xiao_d 9 GPIO_ACTIVE_HIGH> 
            , <&xiao_d 8 GPIO_ACTIVE_HIGH> 
            , <&xiao_d 7 GPIO_ACTIVE_HIGH> 
            , <&gpio0 10 GPIO_ACTIVE_HIGH>
            , <&gpio0 9 GPIO_ACTIVE_HIGH>
            ;
};

&left_encoder {
    status = "okay";
};